## conf/layer.conf
```bitbake
# We have a conf and classes directory, append to BBPATH
BBPATH .= ":${LAYERDIR}"

BBFILES += "\
    ${LAYERDIR}/recipes-*/*/*.bb \
    ${LAYERDIR}/recipes-*/*/*.bbappend"

BBFILE_COLLECTIONS += "office-layer"
BBFILE_PATTERN_office-layer := "^${LAYERDIR}/"

# qt is 7 :(  
BBFILE_PRIORITY_office-layer = "8"

LAYERDEPENDS_office-layer = " \
    yocto core \
    openembedded-layer \
    gnome-layer \
    meta-python \
    perl-layer \
    networking-layer \
    multimedia-layer \
    filesystems-layer \
"

LAYERRECOMMENDS_office-layer = "\
    clang-layer \
    qt6-layer qt5-layer meta-python2 \
    virtualization-layer \
    meta-openjdk-temurin \
    xfce-layer webserver \
    meta-initramfs \
    meta-noto \
"

# seperate so users have build time options
BBFILES_DYNAMIC += " \
    qt6-layer:${LAYERDIR}/dynamic-layers/qt6-layer/recipes-*/*/*.bb \
    qt6-layer:${LAYERDIR}/dynamic-layers/qt6-layer/recipes-*/*/*.bbappend \
    gnome-layer:${LAYERDIR}/dynamic-layers/gnome-layer/recipes-*/*/*.bb \
    gnome-layer:${LAYERDIR}/dynamic-layers/gnome-layer/recipes-*/*/*.bbappend \
"

LAYERSERIES_COMPAT_office-layer = "scarthgap"
SIGGEN_EXCLUDE_SAFE_RECIPE_DEPS += " \
    libreoffice-dictionaries->hunspell \
"
```
